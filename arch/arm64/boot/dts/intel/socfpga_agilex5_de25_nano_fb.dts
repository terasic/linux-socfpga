// SPDX-License-Identifier: GPL-2.0-only
/*
 * Copyright (C) 2023, Intel Corporation
 */
#include "socfpga_agilex5_de25_nano.dts"

&soc {
	framebuffer_reader@20020000{
		compatible = "altr,vvp-frame-buffer-1.0";
		reg = <0x20020000 0x200>;
		altr,max-width = <1280>;
		altr,max-height= <720>;
		altr,bits-per-symbol = <8>;
		altr,mem-port-width = <256>;
		status = "okay";
	};
};
